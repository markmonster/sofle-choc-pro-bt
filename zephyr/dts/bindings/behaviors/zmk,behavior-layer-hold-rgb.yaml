## zephyr/dts/bindings/behaviors/zmk,behavior-layer-hold-rgb.yaml
```yaml
description: Custom behavior for momentary layer hold with RGB color changes

compatible: "zmk,behavior-layer-hold-rgb"

include: zero_param.yaml

properties:
  layer:
    type: int
    required: true

  hold-hue:
    type: int
    required: true

  hold-sat:
    type: int
    required: true

  hold-bri:
    type: int
    required: true

  base-hue:
    type: int
    required: true

  base-sat:
    type: int
    required: true

  base-bri:
    type: int
    required: true

  locking:
    type: boolean
```
