## boards/nithinskurien/corne_choc_pro/board.yml
```yaml
boards:
  - name: corne_choc_pro_left
    vendor: nithinskurien
    socs:
      - name: nrf52840
  - name: corne_choc_pro_right
    vendor: nithinskurien
    socs:
      - name: nrf52840
```

## zephyr/Kconfig
```kconfig
menu "Sofle Custom Behaviors"

config ZMK_BEHAVIOR_LAYER_HOLD_RGB
    bool "Layer hold RGB behavior"
    depends on ZMK_KEYMAP
    depends on ZMK_RGB_UNDERGLOW
    default y
    help
      Custom behavior that sets underglow color and activates a momentary
      layer on press, then deactivates the layer and restores base color
      on release.

endmenu
```
